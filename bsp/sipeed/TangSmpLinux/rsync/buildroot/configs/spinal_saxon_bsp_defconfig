## bsp/sipeed/TangSmpLinux/rsync/buildroot/configs/spinal_saxon_bsp_defconfig
```kconfig
# Compilation cache
BR2_CCACHE=y
BR2_CCACHE_DIR="$(HOME)/.buildroot-ccache-saxon_default"

# Target options
BR2_riscv=y
BR2_RISCV_32=y

# Instruction Set Extensions
BR2_riscv_custom=y
BR2_RISCV_ISA_CUSTOM_RVM=y
BR2_RISCV_ISA_CUSTOM_RVA=y
BR2_RISCV_ISA_CUSTOM_RVC=n
BR2_RISCV_ABI_ILP32=y

# GCC
BR2_GCC_VERSION_8_X=y

# System
BR2_TARGET_GENERIC_GETTY=y
BR2_TARGET_GENERIC_GETTY_PORT="hvc0"
BR2_USE_WCHAR=y

# Filesystem
BR2_TARGET_ROOTFS_CPIO=y

# Linux headers
BR2_PACKAGE_HOST_LINUX_HEADERS_CUSTOM_5_0=y

# Kernel
BR2_LINUX_KERNEL=y
BR2_LINUX_KERNEL_LATEST_VERSION=n
BR2_LINUX_KERNEL_CUSTOM_VERSION=y
BR2_LINUX_KERNEL_CUSTOM_VERSION_VALUE="5.0.9"
BR2_LINUX_KERNEL_USE_CUSTOM_CONFIG=y
BR2_LINUX_KERNEL_CUSTOM_CONFIG_FILE="board/spinal/saxon_bsp/linux.config"
BR2_LINUX_KERNEL_VMLINUX=y

# Rootfs customisation
BR2_ROOTFS_OVERLAY="board/spinal/saxon_bsp/rootfs_overlay"

# U-BOOT
BR2_PACKAGE_HOST_UBOOT_TOOLS=y
BR2_TARGET_ROOTFS_CPIO_UIMAGE=y

# Flashing
#BR2_PACKAGE_MTD=y
#BR2_PACKAGE_MTD_FLASH_ERASE=y
#BR2_PACKAGE_MTD_TESTS=y
#BR2_PACKAGE_MTD_FLASH_SPEED=y
#BR2_PACKAGE_MTD_FLASH_TORTURE=y

# Extra packages
#BR2_PACKAGE_UTIL_LINUX_LSBLK=y
#BR2_PACKAGE_DHRYSTONE=y
#BR2_PACKAGE_RNG_TOOLS=y
#BR2_PACKAGE_BASH=y
BR2_PACKAGE_NANO=y
BR2_PACKAGE_BUSYBOX_SHOW_OTHERS=y
```
